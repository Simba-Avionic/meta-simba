## conf/layer.conf
```bitbake
BBPATH .= ":${LAYERDIR}"

# We have recipes-* directories, add to BBFILES
BBFILES += "${LAYERDIR}/recipes-*/*/*.bb \
            ${LAYERDIR}/recipes-*/*/*.bbappend"

BBFILE_COLLECTIONS += "meta-simba"
BBFILE_PATTERN_meta-simba = "^${LAYERDIR}/"
BBFILE_PRIORITY_meta-simba = "6"

LAYERDEPENDS_meta-simba = "core"
LAYERSERIES_COMPAT_meta-simba = "mickledore"
```
